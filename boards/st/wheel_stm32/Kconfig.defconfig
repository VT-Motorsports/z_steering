## boards/st/wheel_stm32/Kconfig.defconfig
```kconfig
# Copyright (c) 2025 Wheel Team
# SPDX-License-Identifier: Apache-2.0

if BOARD_WHEEL_STM32

config BOARD
	default "wheel_stm32"

endif # BOARD_WHEEL_STM32
```

## boards/st/wheel_stm32/Kconfig.vcu_stm32
```kconfig
# Copyright (c) 2025 Wheel Team
# SPDX-License-Identifier: Apache-2.0

config BOARD_WHEEL_STM32
	select SOC_STM32H753XX
```

## boards/st/wheel_stm32/wheel_stm32_defconfig
```kconfig
# wheel_stm32_defconfig

# Clock Configuration
CONFIG_CLOCK_CONTROL=y

# GPIO and Pin Muxing
CONFIG_GPIO=y
CONFIG_PINCTRL=y

# Serial / Console (for debugging)
CONFIG_SERIAL=y
CONFIG_UART_CONSOLE=y

# CAN Bus
CONFIG_CAN=y
CONFIG_CAN_FD_MODE=y
```
